## boards/shields/mysplit/Kconfig.defconfig
```kconfig
if SHIELD_MYSPLIT_LEFT || SHIELD_MYSPLIT_RIGHT
config ZMK_SPLIT
    default y
endif

if SHIELD_MYSPLIT_RIGHT
config ZMK_SPLIT_ROLE_CENTRAL
    default y
endif
```
